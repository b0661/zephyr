## arch/arm/soc/st_stm32/stm32f0/Kconfig.defconfig.series
```kconfig
# Kconfig - ST Microelectronics STM32F0 MCU line
#
# Copyright (c) 2017 RnDity Sp. z o.o.
#
# SPDX-License-Identifier: Apache-2.0
#

if SOC_SERIES_STM32F0X

source "arch/arm/soc/st_stm32/stm32f0/Kconfig.defconfig.stm32f0*"

config SOC_SERIES
	default stm32f0

config PINCTRL
	default y

config GPIO_LEGACY_API
	default n

config SPI_LEGACY_API
	default n

if I2C && (I2C_1 || I2C_2 || I2C_3)

config  I2C_STM32_V2
	default y

endif # I2C

endif # SOC_SERIES_STM32F0X
```

## drivers/pinctrl/Kconfig
```kconfig
# Kconfig - Pinctrl configuration options

#
# Copyright (c) 2018 Bobby Noelte
#
# SPDX-License-Identifier: Apache-2.0
#

config PINCTRL_HAS_DRIVER
	bool
	help
	  This is an option to be enabled by a individual pinctrl driver
	  to signal that there is a pinctrl driver. This is being used
	  by other drivers which are dependent on pinctrl.

#
# Pinctrl options
#
menuconfig PINCTRL
	bool "PINCTRL driver"
	default n
	help
	  Enable PINCTRL Driver Configuration

if PINCTRL

# Include these first so that any properties (e.g. defaults) below can be
# overriden (by defining symbols in multiple locations)
source "drivers/pinctrl/Kconfig.stm32"


config PINCTRL_RUNTIME_DTS
	bool "Enable run time pin configuration control based on DTS"
	default y
	help
	  Supports extended pin controller functionality.

	  Enable if run time pin configuration control based on
	  device tree information is needed.

config PINCTRL_PINMUX
	bool "Enable generic PINMUX interface for pinctrl drivers"
	default y
	help
	  Map PINMUX functions to PINCTRL functions.

	  Enable to use the PINMUX interface with pinctrl drivers.
	  This interface is for transition. Only use if necessary
	  by drivers calling this interface.

config PINCTRL_INIT_PRIORITY
	int
	prompt "Init priority"
	default 2
	help
	  Pinctrl driver initialization priority.

	  Pinctrl driver almost certainly should be initialized before the
	  rest of hardware devices (which may need specific pins already
	  configured for them).
	  Thus, its priority should be between KERNEL_INIT_PRIORITY_DEFAULT
	  and KERNEL_INIT_PRIORITY_DEVICE. There are exceptions to this
	  rule for particular boards. Don't change this value unless you
	  know what you are doing.

module = PINCTRL
module-str = pinctrl driver
source "subsys/logging/Kconfig.template.log_config"

endif # PINCTRL
```

## drivers/pinctrl/Kconfig.stm32
```kconfig
# Kconfig - configuration for STM32 pinctrl
#
# Copyright (c) 2018 Bobby Noelte
#
# SPDX-License-Identifier: Apache-2.0
#

config PINCTRL_STM32
	bool "Pinctrl driver for STM32 MCUs"
	select PINCTRL_HAS_DRIVER
	default y if PINCTRL && SOC_FAMILY_STM32
	select USE_STM32_LL_EXTI
	select USE_STM32_LL_GPIO
	select USE_STM32_LL_SYSTEM
	help
	 Enable pin controller for STM32 MCUs
```

## dts/bindings/pinctrl/st,stm32-pinctrl.yaml
```yaml
---
title: STM32 PINCTRL
type: st,stm32-pinctrl
version: 0.1

description: >
    This binding gives a base representation of the STM32 PINCTRL

inherits:
    !include pinctrl.yaml

properties:
    compatible:
      constraint: "st,stm32-pinctrl"

    reg:
      type: int
      description: mmio register space
      generation: define
      category: required

    "#address-cells":
      type: int
      category: required
      description: should be 1.

    "#size-cells":
      type: int
      category: required
      description: should be 0.

# legacy compatibility
"#cells":
  - pin
  - function
...
```

## ext/lib/preprocessor/Kconfig
```kconfig
#
# Copyright (c) 2016 Bobby Noelte
#
# SPDX-License-Identifier: Apache-2.0
#

menu "Preprocessor Libraries"

source "ext/lib/preprocessor/chaos/Kconfig"

endmenu
```

## ext/lib/preprocessor/chaos/Kconfig
```kconfig
# Kconfig - CHAOS Preprocessor Library

#
# Copyright (c) 2017 Bobby Noelte
#
# SPDX-License-Identifier: Apache-2.0
#

config CHAOS
	bool
	prompt "CHAOS Preprocessor Library"
	default y
	help
	This option enables the CHAOS preprocessor library.
	The Chaos Preprocessor Library is a generative metaprogramming
	framework for C and C++. It is a header file only library.
```
